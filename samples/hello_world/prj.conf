## prj.conf
```kconfig
CONFIG_DEBUG=y
CONFIG_SRAM_SIZE=128
CONFIG_SYS_CLOCK_HW_CYCLES_PER_SEC=50000000
CONFIG_SRAM_BASE_ADDRESS=0x0
CONFIG_TICKLESS_KERNEL=n
```

## src/main.c
```c
/*
 * Copyright (c) 2012-2014 Wind River Systems, Inc.
 *
 * SPDX-License-Identifier: Apache-2.0
 */

#include <zephyr.h>
#include <sys/printk.h>

bool g_debug = false;
char *version = "POC";

void main(void)
{
    //while loop
    while(g_debug == true){};

    printk("Hello World loop 5 times\n");
    for(int i=0;i<5;i++) {
	printk("%d: Hello World from RISCV Zephyr! BOARD=%s, version=%s.\n",i+1, CONFIG_BOARD, version);
    }

    printk("main End\n");
    return;
}
```
