## boards/riscv/niosv_m_a10soc/Kconfig.board
```kconfig
# SPDX-License-Identifier: Apache-2.0

config BOARD_NIOSV_M_A10SOC
	bool "Intel NIOSV/m Arria10SOC"
	depends on SOC_INTEL_RISCV_M
```

## boards/riscv/niosv_m_a10soc/Kconfig.defconfig
```kconfig
# SPDX-License-Identifier: Apache-2.0

if BOARD_NIOSV_M_A10SOC

config BOARD
	default "niosv_m_a10soc"

endif # BOARD_NIOSV_M_A10SOC
```

## boards/riscv/niosv_m_a10soc/niosv_m_a10soc_defconfig
```kconfig
# SPDX-License-Identifier: Apache-2.0

CONFIG_SOC_SERIES_INTEL_NIOSV=y
CONFIG_SOC_INTEL_RISCV_M=y
CONFIG_BOARD_NIOSV_M_A10SOC=y
CONFIG_CONSOLE=y
CONFIG_PRINTK=y
CONFIG_SERIAL=y
CONFIG_UART_CONSOLE=y
CONFIG_UART_ALTERA_JTAG=y 
CONFIG_RISCV_MACHINE_TIMER=y
CONFIG_XIP=n
#CONFIG_HAS_ALTERA_HAL=y
```

## modules/Kconfig.altera
```kconfig
# Altera HAL drivers configuration

# Copyright (c) 2017 Intel Corporation
# SPDX-License-Identifier: Apache-2.0

config HAS_ALTERA_HAL
	bool "Altera HAL drivers support"
	depends on NIOS2 || SOC_SERIES_INTEL_NIOSV
```

## soc/riscv/riscv-privilege/intel-niosv/Kconfig.defconfig.series
```kconfig
# SPDX-License-Identifier: Apache-2.0

if SOC_SERIES_INTEL_NIOSV

config SOC_SERIES
	default "intel-niosv"

# TBD extract from dts 
# default $(dt_node_int_prop_int,/cpus/cpu@0,clock-frequency) if RISCV_MACHINE_TIMER
# system.h define ALT_CPU_FREQ 50000000
config SYS_CLOCK_HW_CYCLES_PER_SEC
	default 10000000

config NUM_IRQS
	default 16

config RISCV_HAS_CPU_IDLE
	default y

config RISCV_GP
	default y

config RISCV_SOC_INTERRUPT_INIT
    default y

## TBD extract from dts
config SRAM_SIZE
    default 100000 

endif # 
```

## soc/riscv/riscv-privilege/intel-niosv/Kconfig.series
```kconfig
# SPDX-License-Identifier: Apache-2.0

config SOC_SERIES_INTEL_NIOSV
	bool "INTEL NIOSV Processor"
	select RISCV
	select SOC_FAMILY_RISCV_PRIVILEGE
	help
	  Enable support for the INTEL NIOSV Processor.
```

## soc/riscv/riscv-privilege/intel-niosv/Kconfig.soc
```kconfig
# SPDX-License-Identifier: Apache-2.0

choice
	prompt "INTEL NIOSV SOC"
	depends on SOC_SERIES_INTEL_NIOSV

config SOC_INTEL_RISCV_M
	bool "Intel NIOSV Microcontroller"
	select ATOMIC_OPERATIONS_C
	select INCLUDE_RESET_VECTOR

endchoice
```
