/* SPDX-License-Identifier: Apache-2.0 */

/dts-v1/;

#include <intel-niosv.dtsi>

/ {
	model = "arria10soc";
	compatible = "intel,niosv_m_a10soc";

	chosen {
		zephyr,console = &uart0;
	};
};

&uart0 {
	status = "okay";
};
